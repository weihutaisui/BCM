## HGU_BCM68580/02_src_502L04patch2/bcmdrivers/opensource/char/tzdrv/astra_tdrv/Kconfig.autodetect
```kconfig
config BCM_ASTRA_TDRV
	tristate "Support for BCM_ASTRA_TDRV"
	default m if BCM_ASTRA

config BCM_ASTRA_TDRV_IMPL
	int "Implementation index for BCM_ASTRA_TDRV"
	depends on BCM_ASTRA_TDRV
	default 1
```

## HGU_BCM68580/02_src_502L04patch2/bcmdrivers/opensource/char/tzdrv/bcm_astra/Kconfig.autodetect
```kconfig
config BCM_ASTRA_DRV
	tristate "Support for BCM_ASTRA_DRV"
	default m if BCM_ASTRA
	
config BCM_ASTRA_DRV_IMPL
	int "Implementation index for BCM_ASTRA_DRV"
	depends on BCM_ASTRA_DRV
	default 1
```

## HGU_BCM68580/02_src_502L04patch2/bcmdrivers/opensource/char/tzdrv/cpuload_tdrv/Kconfig.autodetect
```kconfig
config BCM_CPULOAD_TDRV
	tristate "Support for BCM_CPULOAD_TDRV"
	default m if BCM_ASTRA
	
config BCM_CPULOAD_TDRV_IMPL
	int "Implementation index for BCM_CPULOAD_TDRV"
	depends on BCM_CPULOAD_TDRV
	default 1
```

## HGU_BCM68580/02_src_502L04patch2/bcmdrivers/opensource/char/tzdrv/cryptoflow_tdrv/Kconfig.autodetect
```kconfig
config BCM_CRYPTOFLOW_TDRV
	tristate "Support for BCM_CRYPTOFLOW_TDRV"
	default m if BCM_ASTRA
	
config BCM_CRYPTOFLOW_TDRV_IMPL
	int "Implementation index for BCM_CRYPTOFLOW_TDRV"
	depends on BCM_CRYPTOFLOW_TDRV
	default 1
```

## HGU_BCM68580/02_src_502L04patch2/bcmdrivers/opensource/char/tzdrv/tzioc_tdrv/Kconfig.autodetect
```kconfig
config BCM_TZIOC_TDRV
	tristate "Support for BCM_TZIOC_TDRV"
	default m if BCM_ASTRA
	
config BCM_TZIOC_TDRV_IMPL
	int "Implementation index for BCM_TZIOC_TDRV"
	depends on BCM_TZIOC_TDRV
	default 1
```
